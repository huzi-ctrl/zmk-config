## boards/shields/pkb/Kconfig.defconfig
```kconfig
if SHIELD_PKB_LEFT

config ZMK_KEYBOARD_NAME
    default "PKB"

config ZMK_SPLIT_ROLE_CENTRAL
    default y

endif # SHIELD_PKB_LEFT

if SHIELD_PKB_LEFT || SHIELD_PKB_RIGHT

config ZMK_SPLIT
    default y

endif # SHIELD_PKB_LEFT || SHIELD_PKB_RIGHT
```
